## drivers/kernelsu/Kconfig
```kconfig
menu "KernelSU"

config KSU
	tristate "KernelSU function support"
	depends on KPROBES && EXT4_FS
	default y
	help
	  Enable kernel-level root privileges on Android System.
	  Requires CONFIG_KPROBES for kernel hooking support.
	  Requires CONFIG_EXT4_FS for `ext4_unregister_sysfs`.
	  To compile as a module, choose M here: the
	  module will be called kernelsu.

config KSU_DEBUG
	bool "KernelSU debug mode"
	depends on KSU
	default n
	help
	  Enable KernelSU debug mode.

config KSU_MANUAL_SU
    bool "Use manual su"
    depends on KSU
    default y
    help
      Use manual su and authorize the corresponding command line and application via prctl

config KPM
    bool "Enable SukiSU KPM"
    depends on KSU && 64BIT
    default n
    help
      Enabling this option will activate the KPM feature of SukiSU.
      This option is suitable for scenarios where you need to force KPM to be enabled.
      but it may affect system stability.
    select KALLSYMS
    select KALLSYMS_ALL

config KSU_DISABLE_MANAGER
	bool "Disable KernelSU manager integration"
	depends on KSU
	default n
	help
	  Disable manager APK detection and manager-specific handling.
	  Root will be used in place of manager-only functionality.

config KSU_DISABLE_POLICY
	bool "Disable KernelSU policy profiles"
	depends on KSU
	default n
	help
	  Disable per-app root/non-root profile customization.
	  Escalation will always use the default full root profile, and
	  non-root handling will follow the global umount policy only.

config KSU_X86_PATCH_SYSCALL_DISPATCHER
	bool "Dynamically patch x64's hardened syscall dispatcher to support syscall hooks"
	depends on KSU && X86_64
	default n
	help
	  Dynamically patch x64's hardened syscall dispatcher to support syscall hooks. This is a
	  replacement for a kernel source code patch, and is useful for x86_64 LKM mode.

config KSU_HOOK_BISECT
	bool "BISECT: disable syscall hook chain (dispatcher + rc/read/fstat)"
	depends on KSU
	default n
	help
	  Temporary bisect switch: skip dispatcher install, hook manager
	  (sys_enter tracepoint) and the ksud rc/read/fstat table patches.
	  reboot kprobe (fd install) and ioctl stay, so the manager still
	  detects the driver; su interception is disabled.

config KSU_HOOK_NO_MANAGER
	bool "BISECT: disable hook manager only (keep rc/read/fstat hooks)"
	depends on KSU && !KSU_HOOK_BISECT
	default n
	help
	  Keep the ksud boot rc injection (read/fstat table patches) but
	  skip the dispatcher + sys_enter tracepoint + tp_marker machinery.
	  ksud service starts at boot (post-fs-data, allowlist); execve
	  escape and sucompat stay off.

config KSU_SUSFS
	bool "SUSFS patches"
	depends on KSU && THREAD_INFO_IN_TASK && 64BIT
	help
	  Patch and Enable SUSFS to kernel with KernelSU.
	  On 4.14 the susfs backport has no core kprobe hooks, so it is
	  paired with the manual hooks instead of replacing them.

menu "KernelSU - SUSFS"
    depends on KSU_SUSFS

comment "------------------------WARNING-------------------------------"
comment "ReSukiSU will check EVERY hooks in kernel compile process"
comment "If anything mismatch with simonpunk's patch, Kernel compile maybe FAILED!"
comment "See simonpunk's original patch if you face any compile failed due to hook check"
comment "Repo: https://gitlab.com/simonpunk/susfs4ksu"
comment "--------------------------------------------------------------"
config KSU_SUSFS_SUS_PATH
    bool "Enable to hide suspicious path"
    depends on KSU_SUSFS
    default y
    help
        - Allow hiding the user-defined path and all its sub-paths from various system calls.
        - Use "add_sus_path_loop" instead of "add_sus_path" if the user-defined path is frequently modified.
        - Use with caution, as it may cause performance loss and be vulnerable to side-channel attacks.
          just disable this feature if it doesn't work for you or you don't need it at all.
        - Effective only on zygote spawned user app process with uid >= 10000.

config KSU_SUSFS_SUS_MOUNT
    bool "Enable to hide suspicious mounts"
    depends on KSU_SUSFS
    default y
    help
        - Automatically assign fake mnt_id and fake mnt_group_id for mounts mounted by ksu process until /sdcard is decrypted, this is to evade from mnt_id/mnt_group_id gap detections.
        - Allow hiding all sus mounts from /proc/self/[mounts|mountinfo|mountstat] for non-su processes.

config KSU_SUSFS_SUS_KSTAT
    bool "Enable to spoof suspicious kstat"
    depends on KSU_SUSFS
    default y
    help
        - Allow spoofing the kstat of user-defined file/directory.
        - Effective only on zygote spawned user app process with uid >= 10000.

config KSU_SUSFS_SPOOF_UNAME
    bool "Enable to spoof uname"
    depends on KSU_SUSFS
    default y
    help
        - Allow spoofing the string returned by uname syscall to user-defined string.
        - Effective on all processes.

config KSU_SUSFS_ENABLE_LOG
    bool "Enable logging susfs log to kernel"
    depends on KSU_SUSFS
    default y
    help
        - Allow logging susfs log to kernel, uncheck it to completely disable all susfs log.

config KSU_SUSFS_HIDE_KSU_SUSFS_SYMBOLS
    bool "Enable to automatically hide ksu and susfs symbols from /proc/kallsyms"
    depends on KSU_SUSFS
    default y
    help
        - Automatically hide ksu and susfs symbols from '/proc/kallsyms'.
        - Effective on all processes.

config KSU_SUSFS_SPOOF_CMDLINE_OR_BOOTCONFIG
    bool "Enable to spoof /proc/bootconfig (gki) or /proc/cmdline (non-gki)"
    depends on KSU_SUSFS
    default y
    help
        - Spoof the output of /proc/bootconfig (gki) or /proc/cmdline (non-gki) with a user-defined file.
        - Effective on all processes.

config KSU_SUSFS_OPEN_REDIRECT
    bool "Enable to redirect a path to be opened with another path (experimental)"
    depends on KSU_SUSFS
    default y
    help
        - Allow redirecting a target path to be opened with another user-defined path.
        - Please be reminded that process with open access to the target and redirected path can be detected.
        - Effective only on processes with uid < 2000.

config KSU_SUSFS_SUS_MAP
    bool "Enable hiding some mmapped real files from different proc maps interfaces"
    depends on KSU_SUSFS
    default y
    help
        - Allow hiding mmapped real files from /proc/<pid>/[maps|smaps|smaps_rollup|map_files|mem|pagemap]
        - It does NOT support hiding anon memory.
        - It does NOT hide any inline hooks or PLT hooks caused by the injected library itself.
        - It may not be able to evade detections by apps that implement a good injection detection.
        - Effective only on zygote spawned umounted user app process >= 10000.


endmenu

config KSU_SUSFS_TRY_UMOUNT
    bool "Enable to try umount for ksu"
    depends on KSU_SUSFS
    default y
    help
        - Allow umounting user-defined paths for zygote spawned user app processes (uid >= 10000).
        - Also provides umount for current mount namespace and zygote isolated services.

config KSU_SUSFS_SUS_SU
    bool "Enable to hide the su path via sus_path hooks"
    depends on KSU_SUSFS
    depends on KSU_SUSFS_SUS_PATH
    default y
    help
        - Marks su binaries (/system/bin/su etc.) with INODE_STATE_SUS_PATH so
          zygote spawned user app processes cannot see or access them.
        - Non-kprobe implementation for 4.14: direct inode marking.

config KSU_SUSFS_SUS_SDCARD_MONITOR
    bool "Enable sdcard monitor to auto hide the Android data dir"
    depends on KSU_SUSFS
    depends on KSU_SUSFS_SUS_PATH
    default y
    help
        - Watches /data/media/0 with fsnotify; when the Android directory is
          created, refreshes sus_path rules so apps cannot see it.
endmenu
```
